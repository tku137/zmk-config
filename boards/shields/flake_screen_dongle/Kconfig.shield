## boards/shields/flake_screen_dongle/Kconfig.shield
```kconfig
# No whitespace after the comma or in the keyboard name!
config SHIELD_FLAKE_SCREEN_DONGLE
    def_bool $(shields_list_contains,flake_screen_dongle)
```

## config/boards/shields/anywhy_flake_dongle/Kconfig.defconfig
```kconfig
if SHIELD_ANYWHY_FLAKE_DONGLE
    config ZMK_KEYBOARD_NAME
        default "anywhy_flake_dongle"

    config ZMK_SPLIT
        default y
    config ZMK_SPLIT_ROLE_CENTRAL
        default y
    config ZMK_SPLIT_BLE_CENTRAL_PERIPHERALS
        default 2

    config BT_MAX_CONN
        default 7
    config BT_MAX_PAIRED
        default 7

    config ZMK_STUDIO
        default n
endif
```

## config/boards/shields/flake_screen/Kconfig.defconfig
```kconfig
if SHIELD_FLAKE_SCREEN_DONGLE

config ZMK_KEYBOARD_NAME
    default "Flake Dongle"

config ZMK_SPLIT_ROLE_CENTRAL
    default y

config ZMK_SPLIT
    default y

config ZMK_SPLIT_BLE_CENTRAL_PERIPHERALS
    default 2

config BT_MAX_CONN
    default 7

config BT_MAX_PAIRED
    default 7

endif
```

## config/boards/shields/flake_screen_dongle/Kconfig.shield
```kconfig
# No whitespace after the comma or in the keyboard name!
config SHIELD_ANYWHY_FLAKE_DONGLE
    def_bool $(shields_list_contains,anywhy_flake_dongle)
```

## config/west.yml
```yaml
manifest:
  remotes:
    - name: zmkfirmware
      url-base: https://github.com/zmkfirmware
    - name: tku137
      url-base: https://github.com/tku137
  projects:
    - name: zmk
      remote: zmkfirmware
      revision: 9490391e1e4010c83291d437b7f9a71ace244581  # main, Feb 18 2026
      import: app/west.yml
    - name: flake-zmk-module
      remote: tku137
      revision: feat/zephyr-4.1
    - name: prospector-zmk-module
      remote: tku137
      revision: feat/new-status-screens
  self:
    path: config
```
